## conf/layer.conf
```bitbake
# We have a conf and classes directory, add to BBPATH
BBPATH .= ":${LAYERDIR}"

# We have recipes-* directories, add to BBFILES
BBFILES += "${LAYERDIR}/recipes-*/*/*.bb \
            ${LAYERDIR}/recipes-*/*/*.bbappend"

BBFILE_COLLECTIONS += "meta-evalue"
BBFILE_PATTERN_meta-evalue = "^${LAYERDIR}/"
BBFILE_PRIORITY_meta-evalue = "6"

LAYERDEPENDS_meta-evalue = "core"
LAYERSERIES_COMPAT_meta-evalue = "mickledore"
```
